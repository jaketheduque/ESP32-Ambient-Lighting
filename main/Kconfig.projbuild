## main/Kconfig.projbuild
```kconfig
menu "ESP WiFi Configuration"
    config ESP_WIFI_SSID
        string "WiFi SSID"
        default "myssid"
        help
            SSID (network name) for the example to connect to.
    config ESP_WIFI_PASSWORD
        string "WiFi Password"
        default "mypassword"
        help
            WiFi password (WPA or WPA2) for the example to use.
    config ESP_WIFI_CHANNEL
        int "WiFi Channel"
        range 1 13
        default 1
        help
            WiFi channel (network channel) for the example to use.
    config ESP_MAX_STA_CONN
        int "Maximal STA connections"
        default 4
        help
            Max number of the STA connects to AP.
endmenu

menu "Ambient Lighting GPIO Configuration"
  config DASHBOARD_GPIO
    int "Dashboard GPIO"
    default 12
    help
      GPIO pin number for the dashboard ambient light.

  config DASHBOARD_MAX_LEDS
    int "Dashboard Max LEDs"
    default 75
    help
      Maximum number of LEDs for the dashboard ambient light.

  config CENTER_GPIO
    int "Center GPIO"
    default 14
    help
      GPIO pin number for the center ambient light.

  config CENTER_MAX_LEDS
    int "Center Max LEDs"
    default 110
    help
      Maximum number of LEDs for the center ambient light.

  config DOOR_GPIO
    int "Door GPIO"
    default 27
    help
      GPIO pin number for the door ambient light.

  config DOOR_MAX_LEDS
    int "Door Max LEDs"
    default 75
    help
      Maximum number of LEDs for the door ambient light.
endmenu

menu "Task Configuration"
  config CAN_SNIFFER_TASK_PRIORITY
    int "CAN Bus Sniffer Task Priority"
    range 1 25
    default 10
    help
      Priority level for the CAN bus sniffer task.

  config CAN_SNIFFER_TASK_CORE
    int "CAN Bus Sniffer Task Core Affinity"
    range 0 1
    default 1
    help
      Core affinity for the CAN bus sniffer task (0 or 1).

  config HTTP_SERVER_TASK_PRIORITY
    int "HTTP Server Task Priority"
    range 1 25
    default 8
    help
      Priority level for the HTTP server task.

  config HTTP_SERVER_TASK_CORE
    int "HTTP Server Task Core Affinity"
    range 0 1
    default 0
    help
      Core affinity for the HTTP server task (0 or 1).

  config LIGHT_CONTROLLER_TASK_PRIORITY
    int "Light Controller Task Priority"
    range 1 25
    default 6
    help
      Priority level for the light controller task.

  config LIGHT_CONTROLLER_TASK_CORE
    int "Light Controller Task Core Affinity"
    range 0 1
    default 0
    help
      Core affinity for the light controller task (0 or 1).
endmenu
```
